## firmware/main/Kconfig.projbuild
```kconfig
menu "Hava Sensor Dugumu"
    config WIFI_SSID
        string "Wi-Fi SSID"
        default ""
    config WIFI_PASSWORD
        string "Wi-Fi sifre"
        default ""
    config MQTT_URI
        string "MQTT adresi (WebSocket, TLS)"
        default "wss://public.cloud.shiftr.io:443"
    config MQTT_USER
        string "MQTT kullanici"
        default "public"
    config MQTT_PASS
        string "MQTT sifre"
        default "public"
    config MQTT_TOPIC
        string "Yayin konusu"
        default "yavuz-hava-istasyonu/data"
    config PUBLISH_SECONDS
        int "Olcum ve yayin araligi (sn)"
        default 60
    choice SENSOR_KIND
        prompt "Sensor"
        default SENSOR_BME280
        config SENSOR_BME280
            bool "BME280 (I2C, sensor karti)"
        config SENSOR_DHT22
            bool "DHT22 (tek tel, alternatif sensor)"
    endchoice
    config SENSOR_PIN
        int "DHT22 veri pini"
        default 4
    config I2C_SDA
        int "I2C SDA pini (BME280)"
        default 4
    config I2C_SCL
        int "I2C SCL pini (BME280)"
        default 5
    config DISPLAY_ST7789
        bool "T-Display-S3 dahili ekranini kullan (ST7789, paralel i80)"
        default n
        help
            Ana kartta (ESP32-C3) ekran yok; bu yalnizca T-Display-S3 gelistirme kartinda
            calisir. Olcumu 3 satir (sicaklik, nem, varsa basinc) olarak ekrana yazar.
endmenu
```

## firmware/sdkconfig.defaults
```kconfig
CONFIG_IDF_TARGET="esp32c3"
CONFIG_ESP_TLS_USING_MBEDTLS=y
CONFIG_MBEDTLS_CERTIFICATE_BUNDLE=y
CONFIG_ESPTOOLPY_FLASHSIZE_4MB=y
CONFIG_ESP_CONSOLE_USB_SERIAL_JTAG=y
CONFIG_COMPILER_OPTIMIZATION_SIZE=y
CONFIG_PARTITION_TABLE_SINGLE_APP_LARGE=y
CONFIG_ESP_MAIN_TASK_STACK_SIZE=8192
```
